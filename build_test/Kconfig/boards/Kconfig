## build_test/Kconfig/boards/Kconfig
```kconfig
# Load Zephyr board Kconfig descriptions.
osource "/home/emir/zephyrproject/zephyr/boards/native/native_sim/Kconfig"
```

## build_test/Kconfig/boards/Kconfig.defconfig
```kconfig
# Load Zephyr board defconfig descriptions.
osource "/home/emir/zephyrproject/zephyr/boards/native/native_sim/Kconfig.defconfig"
```

## build_test/Kconfig/boards/Kconfig.native_sim
```kconfig
# Load board Kconfig descriptions.
osource "/home/emir/zephyrproject/zephyr/boards/native/native_sim/Kconfig.native_sim"
```

## build_test/Kconfig/boards/Kconfig.sysbuild
```kconfig
# Load Sysbuild board Kconfig descriptions.
osource "/home/emir/zephyrproject/zephyr/boards/native/native_sim/Kconfig.sysbuild"
```
